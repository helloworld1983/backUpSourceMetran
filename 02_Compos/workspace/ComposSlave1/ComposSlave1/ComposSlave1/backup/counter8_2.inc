;;*****************************************************************************
;;*****************************************************************************
;;  FILENAME: Counter8_2.inc
;;   Version: 2.60, Updated on 2010/9/19 at 23:39:54
;;  Generated by PSoC Designer 5.1.1875.0
;;
;;  DESCRIPTION: Assembler declarations for the Counter8 user module interface
;;-----------------------------------------------------------------------------
;;  Copyright (c) Cypress Semiconductor 2010. All Rights Reserved.
;;*****************************************************************************
;;*****************************************************************************

include "m8c.inc"


;--------------------------------------------------
; Constants for Counter8_2 API's.
;--------------------------------------------------

Counter8_2_CONTROL_REG_START_BIT:          equ 0x01    ; Control register start bit
Counter8_2_INT_REG:                        equ 0x0e1
Counter8_2_INT_MASK:                       equ 0x40


;--------------------------------------------------
; Constants for Counter8_2 user defined values
;--------------------------------------------------

Counter8_2_PERIOD:                         equ 0xff
Counter8_2_COMPARE_VALUE:                  equ 0x00


;--------------------------------------------------
; Register Address Constants for Counter8_2
;--------------------------------------------------

Counter8_2_COUNTER_REG:                equ 0x38   ; DR0 Counter register
Counter8_2_PERIOD_REG:                 equ 0x39   ; DR1 Period register
Counter8_2_COMPARE_REG:                equ 0x3a   ; DR2 CompareValue register
Counter8_2_CONTROL_REG:                equ 0x3b   ; Control register
Counter8_2_FUNC_REG:                   equ 0x38   ; Function register
Counter8_2_INPUT_REG:                  equ 0x39   ; Input register
Counter8_2_OUTPUT_REG:                 equ 0x3a   ; Output register


;--------------------------------------------------
; Counter8_2 Macro 'Functions'
;--------------------------------------------------

   macro Counter8_2_Start_M
   or    reg[Counter8_2_CONTROL_REG],  Counter8_2_CONTROL_REG_START_BIT
   endm

   macro Counter8_2_Stop_M
   and   reg[Counter8_2_CONTROL_REG], ~Counter8_2_CONTROL_REG_START_BIT
   endm

   macro Counter8_2_EnableInt_M
   M8C_EnableIntMask Counter8_2_INT_REG, Counter8_2_INT_MASK
   endm

   macro Counter8_2_DisableInt_M
   M8C_DisableIntMask Counter8_2_INT_REG, Counter8_2_INT_MASK
   endm


; end of file Counter8_2.inc
