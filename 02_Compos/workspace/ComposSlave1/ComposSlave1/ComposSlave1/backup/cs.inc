;;*****************************************************************************
;;*****************************************************************************
;;  FILENAME:   CS.inc
;;  Version: 1.2, Updated on 2009/7/10 at 10:45:0
;;  Generated by PSoC Designer 5.0.985.0
;;
;;  DESCRIPTION:  Assembler declarations for the LED user module interface
;;                for the 22/24/25/26/27xxx PSoC family of devices.
;;-----------------------------------------------------------------------------
;;  Copyright (c) Cypress MicroSystems 2006. All Rights Reserved.
;;*****************************************************************************
;;*****************************************************************************

include "m8c.inc"

CS_Port:      equ   0x0


CS_PortDR:    equ   PRT0DR

CS_PinMask:   equ  0x40

CS_Drive:     equ   0

CS_ON:        equ   0
CS_OFF:       equ   1

;------------------------------------------------------
;  Register Address Constants for  CS
;------------------------------------------------------

;------------------------------------------------------
;  Macros for  CS
;------------------------------------------------------





; end of file CS.inc
