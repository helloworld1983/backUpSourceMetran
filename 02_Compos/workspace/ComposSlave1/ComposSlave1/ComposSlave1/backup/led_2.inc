;;*****************************************************************************
;;*****************************************************************************
;;  FILENAME:   LED_2.inc
;;  Version: 1.40, Updated on 2010/9/19 at 23:40:44
;;  Generated by PSoC Designer 5.1.1875.0
;;
;;  DESCRIPTION:  Assembler declarations for the LED user module interface.
;;-----------------------------------------------------------------------------
;;  Copyright (c) Cypress Semiconductor 2010. All Rights Reserved.
;;*****************************************************************************
;;*****************************************************************************

include "m8c.inc"

LED_2_Port:      equ   0x0


LED_2_PortDR:    equ   PRT0DR

LED_2_PinMask:   equ  0x80

LED_2_Drive:     equ   1

LED_2_ON:        equ   0
LED_2_OFF:       equ   1

;------------------------------------------------------
;  Register Address Constants for  LED_2
;------------------------------------------------------

;------------------------------------------------------
;  Macros for  LED_2
;------------------------------------------------------





; end of file LED_2.inc
