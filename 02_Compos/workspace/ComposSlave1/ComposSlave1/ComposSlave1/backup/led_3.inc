;;*****************************************************************************
;;*****************************************************************************
;;  FILENAME:   LED_3.inc
;;  Version: 1.40, Updated on 2011/3/29 at 14:30:41
;;  Generated by PSoC Designer 5.1.2110.0
;;
;;  DESCRIPTION:  Assembler declarations for the LED user module interface.
;;-----------------------------------------------------------------------------
;;  Copyright (c) Cypress Semiconductor 2011. All Rights Reserved.
;;*****************************************************************************
;;*****************************************************************************

include "m8c.inc"

LED_3_Port:      equ   0x0


LED_3_PortDR:    equ   PRT0DR

LED_3_PinMask:   equ  0x80

LED_3_Drive:     equ   1

LED_3_ON:        equ   0
LED_3_OFF:       equ   1

;------------------------------------------------------
;  Register Address Constants for  LED_3
;------------------------------------------------------

;------------------------------------------------------
;  Macros for  LED_3
;------------------------------------------------------





; end of file LED_3.inc
