;;*****************************************************************************
;;*****************************************************************************
;;  FILENAME:   MOSI.inc
;;  Version: 1.2, Updated on 2009/7/10 at 10:45:0
;;  Generated by PSoC Designer 5.0.985.0
;;
;;  DESCRIPTION:  Assembler declarations for the LED user module interface
;;                for the 22/24/25/26/27xxx PSoC family of devices.
;;-----------------------------------------------------------------------------
;;  Copyright (c) Cypress MicroSystems 2006. All Rights Reserved.
;;*****************************************************************************
;;*****************************************************************************

include "m8c.inc"

MOSI_Port:      equ   0x1


MOSI_PortDR:    equ   PRT1DR

MOSI_PinMask:   equ  0x40

MOSI_Drive:     equ   1

MOSI_ON:        equ   0
MOSI_OFF:       equ   1

;------------------------------------------------------
;  Register Address Constants for  MOSI
;------------------------------------------------------

;------------------------------------------------------
;  Macros for  MOSI
;------------------------------------------------------





; end of file MOSI.inc
