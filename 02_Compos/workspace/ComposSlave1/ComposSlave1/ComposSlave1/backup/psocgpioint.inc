;  Generated by PSoC Designer 5.4.2946
;
; AnalogColumn_InputMUX_1 address and mask equates
AnalogColumn_InputMUX_1_Data_ADDR:	equ	0h
AnalogColumn_InputMUX_1_DriveMode_0_ADDR:	equ	100h
AnalogColumn_InputMUX_1_DriveMode_1_ADDR:	equ	101h
AnalogColumn_InputMUX_1_DriveMode_2_ADDR:	equ	3h
AnalogColumn_InputMUX_1_GlobalSelect_ADDR:	equ	2h
AnalogColumn_InputMUX_1_IntCtrl_0_ADDR:	equ	102h
AnalogColumn_InputMUX_1_IntCtrl_1_ADDR:	equ	103h
AnalogColumn_InputMUX_1_IntEn_ADDR:	equ	1h
AnalogColumn_InputMUX_1_MASK:	equ	1h
; AnalogColumn_InputMUX_1_Data access macros
;   GetAnalogColumn_InputMUX_1_Data macro, return in a
macro GetAnalogColumn_InputMUX_1_Data
	mov		a,[Port_0_Data_SHADE]
	and		a, 1h
endm
;   SetAnalogColumn_InputMUX_1_Data macro
macro SetAnalogColumn_InputMUX_1_Data
	or		[Port_0_Data_SHADE], 1h
	mov		a, [Port_0_Data_SHADE]
	mov		reg[AnalogColumn_InputMUX_1_Data_ADDR], a
endm
;   ClearAnalogColumn_InputMUX_1_Data macro
macro ClearAnalogColumn_InputMUX_1_Data
	and		[Port_0_Data_SHADE], ~1h
	mov		a, [Port_0_Data_SHADE]
	mov		reg[AnalogColumn_InputMUX_1_Data_ADDR], a
endm

; AnalogOutBuf_3 address and mask equates
AnalogOutBuf_3_Data_ADDR:	equ	0h
AnalogOutBuf_3_DriveMode_0_ADDR:	equ	100h
AnalogOutBuf_3_DriveMode_1_ADDR:	equ	101h
AnalogOutBuf_3_DriveMode_2_ADDR:	equ	3h
AnalogOutBuf_3_GlobalSelect_ADDR:	equ	2h
AnalogOutBuf_3_IntCtrl_0_ADDR:	equ	102h
AnalogOutBuf_3_IntCtrl_1_ADDR:	equ	103h
AnalogOutBuf_3_IntEn_ADDR:	equ	1h
AnalogOutBuf_3_MASK:	equ	4h
; AnalogOutBuf_3_Data access macros
;   GetAnalogOutBuf_3_Data macro, return in a
macro GetAnalogOutBuf_3_Data
	mov		a,[Port_0_Data_SHADE]
	and		a, 4h
endm
;   SetAnalogOutBuf_3_Data macro
macro SetAnalogOutBuf_3_Data
	or		[Port_0_Data_SHADE], 4h
	mov		a, [Port_0_Data_SHADE]
	mov		reg[AnalogOutBuf_3_Data_ADDR], a
endm
;   ClearAnalogOutBuf_3_Data macro
macro ClearAnalogOutBuf_3_Data
	and		[Port_0_Data_SHADE], ~4h
	mov		a, [Port_0_Data_SHADE]
	mov		reg[AnalogOutBuf_3_Data_ADDR], a
endm

; LED_2Pin address and mask equates
LED_2Pin_Data_ADDR:	equ	0h
LED_2Pin_DriveMode_0_ADDR:	equ	100h
LED_2Pin_DriveMode_1_ADDR:	equ	101h
LED_2Pin_DriveMode_2_ADDR:	equ	3h
LED_2Pin_GlobalSelect_ADDR:	equ	2h
LED_2Pin_IntCtrl_0_ADDR:	equ	102h
LED_2Pin_IntCtrl_1_ADDR:	equ	103h
LED_2Pin_IntEn_ADDR:	equ	1h
LED_2Pin_MASK:	equ	80h
; LED_2Pin_Data access macros
;   GetLED_2Pin_Data macro, return in a
macro GetLED_2Pin_Data
	mov		a,[Port_0_Data_SHADE]
	and		a, 80h
endm
;   SetLED_2Pin_Data macro
macro SetLED_2Pin_Data
	or		[Port_0_Data_SHADE], 80h
	mov		a, [Port_0_Data_SHADE]
	mov		reg[LED_2Pin_Data_ADDR], a
endm
;   ClearLED_2Pin_Data macro
macro ClearLED_2Pin_Data
	and		[Port_0_Data_SHADE], ~80h
	mov		a, [Port_0_Data_SHADE]
	mov		reg[LED_2Pin_Data_ADDR], a
endm

; LED_1Pin address and mask equates
LED_1Pin_Data_ADDR:	equ	4h
LED_1Pin_DriveMode_0_ADDR:	equ	104h
LED_1Pin_DriveMode_1_ADDR:	equ	105h
LED_1Pin_DriveMode_2_ADDR:	equ	7h
LED_1Pin_GlobalSelect_ADDR:	equ	6h
LED_1Pin_IntCtrl_0_ADDR:	equ	106h
LED_1Pin_IntCtrl_1_ADDR:	equ	107h
LED_1Pin_IntEn_ADDR:	equ	5h
LED_1Pin_MASK:	equ	8h
; LED_1Pin_Data access macros
;   GetLED_1Pin_Data macro, return in a
macro GetLED_1Pin_Data
	mov		a,[Port_1_Data_SHADE]
	and		a, 8h
endm
;   SetLED_1Pin_Data macro
macro SetLED_1Pin_Data
	or		[Port_1_Data_SHADE], 8h
	mov		a, [Port_1_Data_SHADE]
	mov		reg[LED_1Pin_Data_ADDR], a
endm
;   ClearLED_1Pin_Data macro
macro ClearLED_1Pin_Data
	and		[Port_1_Data_SHADE], ~8h
	mov		a, [Port_1_Data_SHADE]
	mov		reg[LED_1Pin_Data_ADDR], a
endm

; EzI2Cs_1SDA address and mask equates
EzI2Cs_1SDA_Data_ADDR:	equ	4h
EzI2Cs_1SDA_DriveMode_0_ADDR:	equ	104h
EzI2Cs_1SDA_DriveMode_1_ADDR:	equ	105h
EzI2Cs_1SDA_DriveMode_2_ADDR:	equ	7h
EzI2Cs_1SDA_GlobalSelect_ADDR:	equ	6h
EzI2Cs_1SDA_IntCtrl_0_ADDR:	equ	106h
EzI2Cs_1SDA_IntCtrl_1_ADDR:	equ	107h
EzI2Cs_1SDA_IntEn_ADDR:	equ	5h
EzI2Cs_1SDA_MASK:	equ	20h
; EzI2Cs_1SDA_Data access macros
;   GetEzI2Cs_1SDA_Data macro, return in a
macro GetEzI2Cs_1SDA_Data
	mov		a,[Port_1_Data_SHADE]
	and		a, 20h
endm
;   SetEzI2Cs_1SDA_Data macro
macro SetEzI2Cs_1SDA_Data
	or		[Port_1_Data_SHADE], 20h
	mov		a, [Port_1_Data_SHADE]
	mov		reg[EzI2Cs_1SDA_Data_ADDR], a
endm
;   ClearEzI2Cs_1SDA_Data macro
macro ClearEzI2Cs_1SDA_Data
	and		[Port_1_Data_SHADE], ~20h
	mov		a, [Port_1_Data_SHADE]
	mov		reg[EzI2Cs_1SDA_Data_ADDR], a
endm

; EzI2Cs_1SCL address and mask equates
EzI2Cs_1SCL_Data_ADDR:	equ	4h
EzI2Cs_1SCL_DriveMode_0_ADDR:	equ	104h
EzI2Cs_1SCL_DriveMode_1_ADDR:	equ	105h
EzI2Cs_1SCL_DriveMode_2_ADDR:	equ	7h
EzI2Cs_1SCL_GlobalSelect_ADDR:	equ	6h
EzI2Cs_1SCL_IntCtrl_0_ADDR:	equ	106h
EzI2Cs_1SCL_IntCtrl_1_ADDR:	equ	107h
EzI2Cs_1SCL_IntEn_ADDR:	equ	5h
EzI2Cs_1SCL_MASK:	equ	80h
; EzI2Cs_1SCL_Data access macros
;   GetEzI2Cs_1SCL_Data macro, return in a
macro GetEzI2Cs_1SCL_Data
	mov		a,[Port_1_Data_SHADE]
	and		a, 80h
endm
;   SetEzI2Cs_1SCL_Data macro
macro SetEzI2Cs_1SCL_Data
	or		[Port_1_Data_SHADE], 80h
	mov		a, [Port_1_Data_SHADE]
	mov		reg[EzI2Cs_1SCL_Data_ADDR], a
endm
;   ClearEzI2Cs_1SCL_Data macro
macro ClearEzI2Cs_1SCL_Data
	and		[Port_1_Data_SHADE], ~80h
	mov		a, [Port_1_Data_SHADE]
	mov		reg[EzI2Cs_1SCL_Data_ADDR], a
endm

