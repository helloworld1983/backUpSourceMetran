;;*****************************************************************************
;;*****************************************************************************
;;  FILENAME: Counter8_1.inc
;;   Version: 2.60, Updated on 2010/9/19 at 23:39:54
;;  Generated by PSoC Designer 5.1.1875.0
;;
;;  DESCRIPTION: Assembler declarations for the Counter8 user module interface
;;-----------------------------------------------------------------------------
;;  Copyright (c) Cypress Semiconductor 2010. All Rights Reserved.
;;*****************************************************************************
;;*****************************************************************************

include "m8c.inc"


;--------------------------------------------------
; Constants for Counter8_1 API's.
;--------------------------------------------------

Counter8_1_CONTROL_REG_START_BIT:          equ 0x01    ; Control register start bit
Counter8_1_INT_REG:                        equ 0x0e1
Counter8_1_INT_MASK:                       equ 0x20


;--------------------------------------------------
; Constants for Counter8_1 user defined values
;--------------------------------------------------

Counter8_1_PERIOD:                         equ 0xff
Counter8_1_COMPARE_VALUE:                  equ 0x00


;--------------------------------------------------
; Register Address Constants for Counter8_1
;--------------------------------------------------

Counter8_1_COUNTER_REG:                equ 0x34   ; DR0 Counter register
Counter8_1_PERIOD_REG:                 equ 0x35   ; DR1 Period register
Counter8_1_COMPARE_REG:                equ 0x36   ; DR2 CompareValue register
Counter8_1_CONTROL_REG:                equ 0x37   ; Control register
Counter8_1_FUNC_REG:                   equ 0x34   ; Function register
Counter8_1_INPUT_REG:                  equ 0x35   ; Input register
Counter8_1_OUTPUT_REG:                 equ 0x36   ; Output register


;--------------------------------------------------
; Counter8_1 Macro 'Functions'
;--------------------------------------------------

   macro Counter8_1_Start_M
   or    reg[Counter8_1_CONTROL_REG],  Counter8_1_CONTROL_REG_START_BIT
   endm

   macro Counter8_1_Stop_M
   and   reg[Counter8_1_CONTROL_REG], ~Counter8_1_CONTROL_REG_START_BIT
   endm

   macro Counter8_1_EnableInt_M
   M8C_EnableIntMask Counter8_1_INT_REG, Counter8_1_INT_MASK
   endm

   macro Counter8_1_DisableInt_M
   M8C_DisableIntMask Counter8_1_INT_REG, Counter8_1_INT_MASK
   endm


; end of file Counter8_1.inc
