;;*****************************************************************************
;;*****************************************************************************
;;  FILENAME:   LED_8.inc
;;  Version: 1.40, Updated on 2011/6/28 at 6:9:35
;;  Generated by PSoC Designer 5.1.2306
;;
;;  DESCRIPTION:  Assembler declarations for the LED user module interface.
;;-----------------------------------------------------------------------------
;;  Copyright (c) Cypress Semiconductor 2011. All Rights Reserved.
;;*****************************************************************************
;;*****************************************************************************

include "m8c.inc"

LED_8_Port:      equ   0x1


LED_8_PortDR:    equ   PRT1DR

LED_8_PinMask:   equ  0x4

LED_8_Drive:     equ   1

LED_8_ON:        equ   0
LED_8_OFF:       equ   1

;------------------------------------------------------
;  Register Address Constants for  LED_8
;------------------------------------------------------

;------------------------------------------------------
;  Macros for  LED_8
;------------------------------------------------------





; end of file LED_8.inc
