;;*****************************************************************************
;;*****************************************************************************
;;  FILENAME:   LED_9.inc
;;  Version: 1.40, Updated on 2011/6/28 at 6:9:35
;;  Generated by PSoC Designer 5.1.2306
;;
;;  DESCRIPTION:  Assembler declarations for the LED user module interface.
;;-----------------------------------------------------------------------------
;;  Copyright (c) Cypress Semiconductor 2011. All Rights Reserved.
;;*****************************************************************************
;;*****************************************************************************

include "m8c.inc"

LED_9_Port:      equ   0x1


LED_9_PortDR:    equ   PRT1DR

LED_9_PinMask:   equ  0x10

LED_9_Drive:     equ   1

LED_9_ON:        equ   0
LED_9_OFF:       equ   1

;------------------------------------------------------
;  Register Address Constants for  LED_9
;------------------------------------------------------

;------------------------------------------------------
;  Macros for  LED_9
;------------------------------------------------------





; end of file LED_9.inc
