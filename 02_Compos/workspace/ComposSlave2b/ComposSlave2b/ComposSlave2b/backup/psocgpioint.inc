;  Generated by PSoC Designer 5.3.2710
;
; LED_8Pin address and mask equates
LED_8Pin_Data_ADDR:	equ	4h
LED_8Pin_DriveMode_0_ADDR:	equ	104h
LED_8Pin_DriveMode_1_ADDR:	equ	105h
LED_8Pin_DriveMode_2_ADDR:	equ	7h
LED_8Pin_GlobalSelect_ADDR:	equ	6h
LED_8Pin_IntCtrl_0_ADDR:	equ	106h
LED_8Pin_IntCtrl_1_ADDR:	equ	107h
LED_8Pin_IntEn_ADDR:	equ	5h
LED_8Pin_MASK:	equ	4h
; LED_8Pin_Data access macros
;   GetLED_8Pin_Data macro, return in a
macro GetLED_8Pin_Data
	mov		a,[Port_1_Data_SHADE]
	and		a, 4h
endm
;   SetLED_8Pin_Data macro
macro SetLED_8Pin_Data
	or		[Port_1_Data_SHADE], 4h
	mov		a, [Port_1_Data_SHADE]
	mov		reg[LED_8Pin_Data_ADDR], a
endm
;   ClearLED_8Pin_Data macro
macro ClearLED_8Pin_Data
	and		[Port_1_Data_SHADE], ~4h
	mov		a, [Port_1_Data_SHADE]
	mov		reg[LED_8Pin_Data_ADDR], a
endm

; LED_1Pin address and mask equates
LED_1Pin_Data_ADDR:	equ	4h
LED_1Pin_DriveMode_0_ADDR:	equ	104h
LED_1Pin_DriveMode_1_ADDR:	equ	105h
LED_1Pin_DriveMode_2_ADDR:	equ	7h
LED_1Pin_GlobalSelect_ADDR:	equ	6h
LED_1Pin_IntCtrl_0_ADDR:	equ	106h
LED_1Pin_IntCtrl_1_ADDR:	equ	107h
LED_1Pin_IntEn_ADDR:	equ	5h
LED_1Pin_MASK:	equ	8h
; LED_1Pin_Data access macros
;   GetLED_1Pin_Data macro, return in a
macro GetLED_1Pin_Data
	mov		a,[Port_1_Data_SHADE]
	and		a, 8h
endm
;   SetLED_1Pin_Data macro
macro SetLED_1Pin_Data
	or		[Port_1_Data_SHADE], 8h
	mov		a, [Port_1_Data_SHADE]
	mov		reg[LED_1Pin_Data_ADDR], a
endm
;   ClearLED_1Pin_Data macro
macro ClearLED_1Pin_Data
	and		[Port_1_Data_SHADE], ~8h
	mov		a, [Port_1_Data_SHADE]
	mov		reg[LED_1Pin_Data_ADDR], a
endm

; LED_9Pin address and mask equates
LED_9Pin_Data_ADDR:	equ	4h
LED_9Pin_DriveMode_0_ADDR:	equ	104h
LED_9Pin_DriveMode_1_ADDR:	equ	105h
LED_9Pin_DriveMode_2_ADDR:	equ	7h
LED_9Pin_GlobalSelect_ADDR:	equ	6h
LED_9Pin_IntCtrl_0_ADDR:	equ	106h
LED_9Pin_IntCtrl_1_ADDR:	equ	107h
LED_9Pin_IntEn_ADDR:	equ	5h
LED_9Pin_MASK:	equ	10h
; LED_9Pin_Data access macros
;   GetLED_9Pin_Data macro, return in a
macro GetLED_9Pin_Data
	mov		a,[Port_1_Data_SHADE]
	and		a, 10h
endm
;   SetLED_9Pin_Data macro
macro SetLED_9Pin_Data
	or		[Port_1_Data_SHADE], 10h
	mov		a, [Port_1_Data_SHADE]
	mov		reg[LED_9Pin_Data_ADDR], a
endm
;   ClearLED_9Pin_Data macro
macro ClearLED_9Pin_Data
	and		[Port_1_Data_SHADE], ~10h
	mov		a, [Port_1_Data_SHADE]
	mov		reg[LED_9Pin_Data_ADDR], a
endm

; EzI2Cs_1SDA address and mask equates
EzI2Cs_1SDA_Data_ADDR:	equ	4h
EzI2Cs_1SDA_DriveMode_0_ADDR:	equ	104h
EzI2Cs_1SDA_DriveMode_1_ADDR:	equ	105h
EzI2Cs_1SDA_DriveMode_2_ADDR:	equ	7h
EzI2Cs_1SDA_GlobalSelect_ADDR:	equ	6h
EzI2Cs_1SDA_IntCtrl_0_ADDR:	equ	106h
EzI2Cs_1SDA_IntCtrl_1_ADDR:	equ	107h
EzI2Cs_1SDA_IntEn_ADDR:	equ	5h
EzI2Cs_1SDA_MASK:	equ	20h
; EzI2Cs_1SDA_Data access macros
;   GetEzI2Cs_1SDA_Data macro, return in a
macro GetEzI2Cs_1SDA_Data
	mov		a,[Port_1_Data_SHADE]
	and		a, 20h
endm
;   SetEzI2Cs_1SDA_Data macro
macro SetEzI2Cs_1SDA_Data
	or		[Port_1_Data_SHADE], 20h
	mov		a, [Port_1_Data_SHADE]
	mov		reg[EzI2Cs_1SDA_Data_ADDR], a
endm
;   ClearEzI2Cs_1SDA_Data macro
macro ClearEzI2Cs_1SDA_Data
	and		[Port_1_Data_SHADE], ~20h
	mov		a, [Port_1_Data_SHADE]
	mov		reg[EzI2Cs_1SDA_Data_ADDR], a
endm

; LED_10Pin address and mask equates
LED_10Pin_Data_ADDR:	equ	4h
LED_10Pin_DriveMode_0_ADDR:	equ	104h
LED_10Pin_DriveMode_1_ADDR:	equ	105h
LED_10Pin_DriveMode_2_ADDR:	equ	7h
LED_10Pin_GlobalSelect_ADDR:	equ	6h
LED_10Pin_IntCtrl_0_ADDR:	equ	106h
LED_10Pin_IntCtrl_1_ADDR:	equ	107h
LED_10Pin_IntEn_ADDR:	equ	5h
LED_10Pin_MASK:	equ	40h
; LED_10Pin_Data access macros
;   GetLED_10Pin_Data macro, return in a
macro GetLED_10Pin_Data
	mov		a,[Port_1_Data_SHADE]
	and		a, 40h
endm
;   SetLED_10Pin_Data macro
macro SetLED_10Pin_Data
	or		[Port_1_Data_SHADE], 40h
	mov		a, [Port_1_Data_SHADE]
	mov		reg[LED_10Pin_Data_ADDR], a
endm
;   ClearLED_10Pin_Data macro
macro ClearLED_10Pin_Data
	and		[Port_1_Data_SHADE], ~40h
	mov		a, [Port_1_Data_SHADE]
	mov		reg[LED_10Pin_Data_ADDR], a
endm

; EzI2Cs_1SCL address and mask equates
EzI2Cs_1SCL_Data_ADDR:	equ	4h
EzI2Cs_1SCL_DriveMode_0_ADDR:	equ	104h
EzI2Cs_1SCL_DriveMode_1_ADDR:	equ	105h
EzI2Cs_1SCL_DriveMode_2_ADDR:	equ	7h
EzI2Cs_1SCL_GlobalSelect_ADDR:	equ	6h
EzI2Cs_1SCL_IntCtrl_0_ADDR:	equ	106h
EzI2Cs_1SCL_IntCtrl_1_ADDR:	equ	107h
EzI2Cs_1SCL_IntEn_ADDR:	equ	5h
EzI2Cs_1SCL_MASK:	equ	80h
; EzI2Cs_1SCL_Data access macros
;   GetEzI2Cs_1SCL_Data macro, return in a
macro GetEzI2Cs_1SCL_Data
	mov		a,[Port_1_Data_SHADE]
	and		a, 80h
endm
;   SetEzI2Cs_1SCL_Data macro
macro SetEzI2Cs_1SCL_Data
	or		[Port_1_Data_SHADE], 80h
	mov		a, [Port_1_Data_SHADE]
	mov		reg[EzI2Cs_1SCL_Data_ADDR], a
endm
;   ClearEzI2Cs_1SCL_Data macro
macro ClearEzI2Cs_1SCL_Data
	and		[Port_1_Data_SHADE], ~80h
	mov		a, [Port_1_Data_SHADE]
	mov		reg[EzI2Cs_1SCL_Data_ADDR], a
endm

