;;*****************************************************************************
;;*****************************************************************************
;;  FILENAME:   LED_1.inc
;;  Version: 1.40, Updated on 2011/6/28 at 6:9:35
;;  Generated by PSoC Designer 5.1.2306
;;
;;  DESCRIPTION:  Assembler declarations for the LED user module interface.
;;-----------------------------------------------------------------------------
;;  Copyright (c) Cypress Semiconductor 2011. All Rights Reserved.
;;*****************************************************************************
;;*****************************************************************************

include "m8c.inc"

LED_1_Port:      equ   0x1


LED_1_PortDR:    equ   PRT1DR

LED_1_PinMask:   equ  0x8

LED_1_Drive:     equ   1

LED_1_ON:        equ   0
LED_1_OFF:       equ   1

;------------------------------------------------------
;  Register Address Constants for  LED_1
;------------------------------------------------------

;------------------------------------------------------
;  Macros for  LED_1
;------------------------------------------------------





; end of file LED_1.inc
