;;*****************************************************************************
;;*****************************************************************************
;;  FILENAME:   LED_10.inc
;;  Version: 1.40, Updated on 2011/9/2 at 9:40:1
;;  Generated by PSoC Designer 5.1.2309
;;
;;  DESCRIPTION:  Assembler declarations for the LED user module interface.
;;-----------------------------------------------------------------------------
;;  Copyright (c) Cypress Semiconductor 2011. All Rights Reserved.
;;*****************************************************************************
;;*****************************************************************************

include "m8c.inc"

LED_10_Port:      equ   0x2


LED_10_PortDR:    equ   PRT2DR

LED_10_PinMask:   equ  0x1

LED_10_Drive:     equ   1

LED_10_ON:        equ   0
LED_10_OFF:       equ   1

;------------------------------------------------------
;  Register Address Constants for  LED_10
;------------------------------------------------------

;------------------------------------------------------
;  Macros for  LED_10
;------------------------------------------------------





; end of file LED_10.inc
