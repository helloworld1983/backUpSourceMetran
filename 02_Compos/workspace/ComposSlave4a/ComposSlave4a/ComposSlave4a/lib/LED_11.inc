;;*****************************************************************************
;;*****************************************************************************
;;  FILENAME:   LED_11.inc
;;  Version: 1.40, Updated on 2011/6/28 at 6:9:35
;;  Generated by PSoC Designer 5.1.2306
;;
;;  DESCRIPTION:  Assembler declarations for the LED user module interface.
;;-----------------------------------------------------------------------------
;;  Copyright (c) Cypress Semiconductor 2011. All Rights Reserved.
;;*****************************************************************************
;;*****************************************************************************

include "m8c.inc"

LED_11_Port:      equ   0x2


LED_11_PortDR:    equ   PRT2DR

LED_11_PinMask:   equ  0x2

LED_11_Drive:     equ   1

LED_11_ON:        equ   0
LED_11_OFF:       equ   1

;------------------------------------------------------
;  Register Address Constants for  LED_11
;------------------------------------------------------

;------------------------------------------------------
;  Macros for  LED_11
;------------------------------------------------------





; end of file LED_11.inc
