;;*****************************************************************************
;;*****************************************************************************
;;  FILENAME:   LED_12.inc
;;  Version: 1.40, Updated on 2011/6/28 at 6:9:35
;;  Generated by PSoC Designer 5.1.2306
;;
;;  DESCRIPTION:  Assembler declarations for the LED user module interface.
;;-----------------------------------------------------------------------------
;;  Copyright (c) Cypress Semiconductor 2011. All Rights Reserved.
;;*****************************************************************************
;;*****************************************************************************

include "m8c.inc"

LED_12_Port:      equ   0x2


LED_12_PortDR:    equ   PRT2DR

LED_12_PinMask:   equ  0x4

LED_12_Drive:     equ   1

LED_12_ON:        equ   0
LED_12_OFF:       equ   1

;------------------------------------------------------
;  Register Address Constants for  LED_12
;------------------------------------------------------

;------------------------------------------------------
;  Macros for  LED_12
;------------------------------------------------------





; end of file LED_12.inc
