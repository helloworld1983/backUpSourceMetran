;;*****************************************************************************
;;*****************************************************************************
;;  FILENAME:   LED_14.inc
;;  Version: 1.40, Updated on 2011/6/28 at 6:9:35
;;  Generated by PSoC Designer 5.1.2306
;;
;;  DESCRIPTION:  Assembler declarations for the LED user module interface.
;;-----------------------------------------------------------------------------
;;  Copyright (c) Cypress Semiconductor 2011. All Rights Reserved.
;;*****************************************************************************
;;*****************************************************************************

include "m8c.inc"

LED_14_Port:      equ   0x2


LED_14_PortDR:    equ   PRT2DR

LED_14_PinMask:   equ  0x10

LED_14_Drive:     equ   1

LED_14_ON:        equ   0
LED_14_OFF:       equ   1

;------------------------------------------------------
;  Register Address Constants for  LED_14
;------------------------------------------------------

;------------------------------------------------------
;  Macros for  LED_14
;------------------------------------------------------





; end of file LED_14.inc
