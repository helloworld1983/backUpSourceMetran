;  Generated by PSoC Designer 5.1.2306
;
; EzI2Cs_1SDA address and mask equates
EzI2Cs_1SDA_Data_ADDR:	equ	4h
EzI2Cs_1SDA_DriveMode_0_ADDR:	equ	104h
EzI2Cs_1SDA_DriveMode_1_ADDR:	equ	105h
EzI2Cs_1SDA_DriveMode_2_ADDR:	equ	7h
EzI2Cs_1SDA_GlobalSelect_ADDR:	equ	6h
EzI2Cs_1SDA_IntCtrl_0_ADDR:	equ	106h
EzI2Cs_1SDA_IntCtrl_1_ADDR:	equ	107h
EzI2Cs_1SDA_IntEn_ADDR:	equ	5h
EzI2Cs_1SDA_MASK:	equ	20h
; EzI2Cs_1SCL address and mask equates
EzI2Cs_1SCL_Data_ADDR:	equ	4h
EzI2Cs_1SCL_DriveMode_0_ADDR:	equ	104h
EzI2Cs_1SCL_DriveMode_1_ADDR:	equ	105h
EzI2Cs_1SCL_DriveMode_2_ADDR:	equ	7h
EzI2Cs_1SCL_GlobalSelect_ADDR:	equ	6h
EzI2Cs_1SCL_IntCtrl_0_ADDR:	equ	106h
EzI2Cs_1SCL_IntCtrl_1_ADDR:	equ	107h
EzI2Cs_1SCL_IntEn_ADDR:	equ	5h
EzI2Cs_1SCL_MASK:	equ	80h
; LED_10Pin address and mask equates
LED_10Pin_Data_ADDR:	equ	8h
LED_10Pin_DriveMode_0_ADDR:	equ	108h
LED_10Pin_DriveMode_1_ADDR:	equ	109h
LED_10Pin_DriveMode_2_ADDR:	equ	bh
LED_10Pin_GlobalSelect_ADDR:	equ	ah
LED_10Pin_IntCtrl_0_ADDR:	equ	10ah
LED_10Pin_IntCtrl_1_ADDR:	equ	10bh
LED_10Pin_IntEn_ADDR:	equ	9h
LED_10Pin_MASK:	equ	1h
; LED_10Pin_Data access macros
;   GetLED_10Pin_Data macro, return in a
macro GetLED_10Pin_Data
	mov		a,[Port_2_Data_SHADE]
	and		a, 1h
endm
;   SetLED_10Pin_Data macro
macro SetLED_10Pin_Data
	or		[Port_2_Data_SHADE], 1h
	mov		a, [Port_2_Data_SHADE]
	mov		reg[LED_10Pin_Data_ADDR], a
endm
;   ClearLED_10Pin_Data macro
macro ClearLED_10Pin_Data
	and		[Port_2_Data_SHADE], ~1h
	mov		a, [Port_2_Data_SHADE]
	mov		reg[LED_10Pin_Data_ADDR], a
endm

; LED_11Pin address and mask equates
LED_11Pin_Data_ADDR:	equ	8h
LED_11Pin_DriveMode_0_ADDR:	equ	108h
LED_11Pin_DriveMode_1_ADDR:	equ	109h
LED_11Pin_DriveMode_2_ADDR:	equ	bh
LED_11Pin_GlobalSelect_ADDR:	equ	ah
LED_11Pin_IntCtrl_0_ADDR:	equ	10ah
LED_11Pin_IntCtrl_1_ADDR:	equ	10bh
LED_11Pin_IntEn_ADDR:	equ	9h
LED_11Pin_MASK:	equ	2h
; LED_11Pin_Data access macros
;   GetLED_11Pin_Data macro, return in a
macro GetLED_11Pin_Data
	mov		a,[Port_2_Data_SHADE]
	and		a, 2h
endm
;   SetLED_11Pin_Data macro
macro SetLED_11Pin_Data
	or		[Port_2_Data_SHADE], 2h
	mov		a, [Port_2_Data_SHADE]
	mov		reg[LED_11Pin_Data_ADDR], a
endm
;   ClearLED_11Pin_Data macro
macro ClearLED_11Pin_Data
	and		[Port_2_Data_SHADE], ~2h
	mov		a, [Port_2_Data_SHADE]
	mov		reg[LED_11Pin_Data_ADDR], a
endm

; LED_12Pin address and mask equates
LED_12Pin_Data_ADDR:	equ	8h
LED_12Pin_DriveMode_0_ADDR:	equ	108h
LED_12Pin_DriveMode_1_ADDR:	equ	109h
LED_12Pin_DriveMode_2_ADDR:	equ	bh
LED_12Pin_GlobalSelect_ADDR:	equ	ah
LED_12Pin_IntCtrl_0_ADDR:	equ	10ah
LED_12Pin_IntCtrl_1_ADDR:	equ	10bh
LED_12Pin_IntEn_ADDR:	equ	9h
LED_12Pin_MASK:	equ	4h
; LED_12Pin_Data access macros
;   GetLED_12Pin_Data macro, return in a
macro GetLED_12Pin_Data
	mov		a,[Port_2_Data_SHADE]
	and		a, 4h
endm
;   SetLED_12Pin_Data macro
macro SetLED_12Pin_Data
	or		[Port_2_Data_SHADE], 4h
	mov		a, [Port_2_Data_SHADE]
	mov		reg[LED_12Pin_Data_ADDR], a
endm
;   ClearLED_12Pin_Data macro
macro ClearLED_12Pin_Data
	and		[Port_2_Data_SHADE], ~4h
	mov		a, [Port_2_Data_SHADE]
	mov		reg[LED_12Pin_Data_ADDR], a
endm

; LED_13Pin address and mask equates
LED_13Pin_Data_ADDR:	equ	8h
LED_13Pin_DriveMode_0_ADDR:	equ	108h
LED_13Pin_DriveMode_1_ADDR:	equ	109h
LED_13Pin_DriveMode_2_ADDR:	equ	bh
LED_13Pin_GlobalSelect_ADDR:	equ	ah
LED_13Pin_IntCtrl_0_ADDR:	equ	10ah
LED_13Pin_IntCtrl_1_ADDR:	equ	10bh
LED_13Pin_IntEn_ADDR:	equ	9h
LED_13Pin_MASK:	equ	8h
; LED_13Pin_Data access macros
;   GetLED_13Pin_Data macro, return in a
macro GetLED_13Pin_Data
	mov		a,[Port_2_Data_SHADE]
	and		a, 8h
endm
;   SetLED_13Pin_Data macro
macro SetLED_13Pin_Data
	or		[Port_2_Data_SHADE], 8h
	mov		a, [Port_2_Data_SHADE]
	mov		reg[LED_13Pin_Data_ADDR], a
endm
;   ClearLED_13Pin_Data macro
macro ClearLED_13Pin_Data
	and		[Port_2_Data_SHADE], ~8h
	mov		a, [Port_2_Data_SHADE]
	mov		reg[LED_13Pin_Data_ADDR], a
endm

; LED_14Pin address and mask equates
LED_14Pin_Data_ADDR:	equ	8h
LED_14Pin_DriveMode_0_ADDR:	equ	108h
LED_14Pin_DriveMode_1_ADDR:	equ	109h
LED_14Pin_DriveMode_2_ADDR:	equ	bh
LED_14Pin_GlobalSelect_ADDR:	equ	ah
LED_14Pin_IntCtrl_0_ADDR:	equ	10ah
LED_14Pin_IntCtrl_1_ADDR:	equ	10bh
LED_14Pin_IntEn_ADDR:	equ	9h
LED_14Pin_MASK:	equ	10h
; LED_14Pin_Data access macros
;   GetLED_14Pin_Data macro, return in a
macro GetLED_14Pin_Data
	mov		a,[Port_2_Data_SHADE]
	and		a, 10h
endm
;   SetLED_14Pin_Data macro
macro SetLED_14Pin_Data
	or		[Port_2_Data_SHADE], 10h
	mov		a, [Port_2_Data_SHADE]
	mov		reg[LED_14Pin_Data_ADDR], a
endm
;   ClearLED_14Pin_Data macro
macro ClearLED_14Pin_Data
	and		[Port_2_Data_SHADE], ~10h
	mov		a, [Port_2_Data_SHADE]
	mov		reg[LED_14Pin_Data_ADDR], a
endm

; LED_15Pin address and mask equates
LED_15Pin_Data_ADDR:	equ	8h
LED_15Pin_DriveMode_0_ADDR:	equ	108h
LED_15Pin_DriveMode_1_ADDR:	equ	109h
LED_15Pin_DriveMode_2_ADDR:	equ	bh
LED_15Pin_GlobalSelect_ADDR:	equ	ah
LED_15Pin_IntCtrl_0_ADDR:	equ	10ah
LED_15Pin_IntCtrl_1_ADDR:	equ	10bh
LED_15Pin_IntEn_ADDR:	equ	9h
LED_15Pin_MASK:	equ	20h
; LED_15Pin_Data access macros
;   GetLED_15Pin_Data macro, return in a
macro GetLED_15Pin_Data
	mov		a,[Port_2_Data_SHADE]
	and		a, 20h
endm
;   SetLED_15Pin_Data macro
macro SetLED_15Pin_Data
	or		[Port_2_Data_SHADE], 20h
	mov		a, [Port_2_Data_SHADE]
	mov		reg[LED_15Pin_Data_ADDR], a
endm
;   ClearLED_15Pin_Data macro
macro ClearLED_15Pin_Data
	and		[Port_2_Data_SHADE], ~20h
	mov		a, [Port_2_Data_SHADE]
	mov		reg[LED_15Pin_Data_ADDR], a
endm

; LED_1Pin address and mask equates
LED_1Pin_Data_ADDR:	equ	8h
LED_1Pin_DriveMode_0_ADDR:	equ	108h
LED_1Pin_DriveMode_1_ADDR:	equ	109h
LED_1Pin_DriveMode_2_ADDR:	equ	bh
LED_1Pin_GlobalSelect_ADDR:	equ	ah
LED_1Pin_IntCtrl_0_ADDR:	equ	10ah
LED_1Pin_IntCtrl_1_ADDR:	equ	10bh
LED_1Pin_IntEn_ADDR:	equ	9h
LED_1Pin_MASK:	equ	80h
; LED_1Pin_Data access macros
;   GetLED_1Pin_Data macro, return in a
macro GetLED_1Pin_Data
	mov		a,[Port_2_Data_SHADE]
	and		a, 80h
endm
;   SetLED_1Pin_Data macro
macro SetLED_1Pin_Data
	or		[Port_2_Data_SHADE], 80h
	mov		a, [Port_2_Data_SHADE]
	mov		reg[LED_1Pin_Data_ADDR], a
endm
;   ClearLED_1Pin_Data macro
macro ClearLED_1Pin_Data
	and		[Port_2_Data_SHADE], ~80h
	mov		a, [Port_2_Data_SHADE]
	mov		reg[LED_1Pin_Data_ADDR], a
endm

