/*******************************************************************************
*                                                                               
*    ﾌｧｲﾙ名 ：  main.c                                                          
*                                                                               
*    概要 ：                                                                    
*          メインルーチン                                                       
*                                                                               
*    公開API :                                                                  
*                                                                               
*    備考 :                                                                     
*                                                                               
*                                                                               
*    変更履歴 :                                                                 
*            日  付    内    容                            Ver No.              
*            --------  ----------------------------------- -------              
*            10.01.20  初版作成                            0.00                 
*            11.12.08  1版作成                             1.00                 
*                                                                               
*******************************************************************************/

#include <m8c.h>			// part specific constants and macros
#include "PSoCAPI.h"		// PSoC API definitions for all User Modules
#include "clock_05ms.h"		// 10,100msecインターバルフラグ
#include "LED_CNT.h"		// 
#include "I2C_CNT.h"		// 
#include "slave_switch.h"

/******************************************************************************
*** RAM・ROM
******************************************************************************/


/******************************************************************************
*** プログラムコード
******************************************************************************/


/******************************************************************************
##
## Name    :main
## Function:メインルーチン
## Input   :なし
## Output  :なし
## Memo    :なし
##
******************************************************************************/
void main(void)
{
	slave_sw_init();
	clock_init();
	PWM8_1_EnableInt();
	I2C_CNT_init();
	
	LED_CNT_init();
	
	LED_1_Start();
	LED_10_Start();
	LED_11_Start();
	LED_12_Start();
	LED_13_Start();
	LED_14_Start();
	LED_15_Start();
	PWM8_1_Start();
	M8C_EnableGInt;
	
	
	while(1)
	{
		//////////////////////////////////////////
		// 100msec単位で実行する処理            //
		//////////////////////////////////////////
		if(flag100ms != 0)						// シリアル送受信低レベル処理
		{
			flag100ms = 0;                      // 100msec周期フラグクリア
			
			LED_1_On();
			I2C_CNT();
			LED_1_Off();
		}
		
		//////////////////////////////////////////
		// 10msec単位で実行する処理             //
		//////////////////////////////////////////
		if(flag10ms != 0)						//
		{
			flag10ms = 0;						// 10msec周期フラグクリア
			
			LED_1_On();
			scan_slave_switch();				// スイッチ入力
			LED_1_Off();
		}
		
		//////////////////////////////////////////
		// 0.5msec単位で実行する処理            //
		//////////////////////////////////////////
		else if(flag05ms != 0)					//
		{
			flag05ms = 0;						// 0.5msec周期フラグクリア
			
			LED_1_On();
			LED_CNT();
			LED_1_Off();
		}
		
	}
}
